## package/clang/Config.in.host
```kconfig
config BR2_PACKAGE_HOST_CLANG
	bool "host clang"
	depends on BR2_PACKAGE_LLVM_ARCH_SUPPORTS
	help
	  Clang is a C++, Objective C and Objective C++ front-end for
	  the LLVM compiler.

	  http://llvm.org
```

## package/festival/Config.in
```kconfig
config BR2_PACKAGE_FESTIVAL
	bool "festival"
	select BR2_PACKAGE_SPEECH_TOOLS
	help
	  Festival Speech Synthesis System

	  http://www.cstr.ed.ac.uk/projects/festival/
```

## package/llvm/Config.in
```kconfig
config BR2_PACKAGE_LLVM_ARCH_SUPPORTS
	bool
	# http://llvm.org/docs/GettingStarted.html#host-c-toolchain-both-compiler-and-standard-library
	# http://llvm.org/docs/GettingStarted.html#local-llvm-configuration
	depends on BR2_HOST_GCC_AT_LEAST_4_8
	default y if BR2_arm || BR2_armeb
	default y if BR2_aarch64
	default y if BR2_i386 || BR2_x86_64
	default y if BR2_mips || BR2_mipsel || BR2_mips64 || BR2_mips64el
	default y if BR2_powerpc || BR2_powerpc64 || BR2_powerpc64le
	default y if BR2_sparc

config BR2_PACKAGE_LLVM_TARGET_ARCH
	string
	default "ARM" if BR2_arm || BR2_armeb
	default "AArch64" if BR2_aarch64
	default "X86" if BR2_i386 || BR2_x86_64
	default "Mips" if BR2_mips || BR2_mipsel || BR2_mips64 || BR2_mips64el
	default "PowerPC" if BR2_powerpc || BR2_powerpc64 || BR2_powerpc64le
	default "Sparc" if BR2_sparc

config BR2_PACKAGE_LLVM
	bool "llvm"
	depends on BR2_PACKAGE_LLVM_ARCH_SUPPORTS
	help
	  The LLVM Project is a collection of modular and reusable
	  compiler and toolchain technologies.

	  http://llvm.org

if BR2_PACKAGE_LLVM

config BR2_PACKAGE_LLVM_TARGET_ARCH_AMDGPU
	bool "AMDGPU"
	help
	  TODO

endif # BR2_PACKAGE_LLVM
```

## package/llvm/Config.in.host
```kconfig
config BR2_PACKAGE_HOST_LLVM
	bool "host llvm"
	depends on BR2_PACKAGE_LLVM_ARCH_SUPPORTS
	help
	  The LLVM Project is a collection of modular and reusable
	  compiler and toolchain technologies.

	  http://llvm.org
```

## package/speech_tools/Config.in
```kconfig
config BR2_PACKAGE_SPEECH_TOOLS
	bool "speech_tools"
	help
	  Festival Speech Synthesis System Speech Tools

	  http://www.cstr.ed.ac.uk/projects/festival/
```
